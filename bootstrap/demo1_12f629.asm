;PROGRAM DEMO_12F629

 list      p=12f629, st=OFF
 #include  <p12f629.inc>
 errorlevel  -302
 errorlevel  -305
 radix	dec

 __CONFIG   _CP_OFF & _CPD_OFF & _BODEN_OFF & _MCLRE_OFF & _WDT_OFF & _PWRTE_ON & _INTRC_OSC_NOCLKOUT

	ORG	00H

DBRK	EQU	1	;SET BREAKPOINTS-DEBUG ON/OFF 1/0
DBEE	EQU	1	;SET EEPROM-READ-CMD   ON/OFF 1/0
 noexpand
BREAK	MACRO	bkn	;BREAKPOINT MACRO DEF
 IF DBRK==1
	MOVWF	DB0
	MOVLW	bkn
	CALL	DBUG
 ENDIF
	ENDM
INSIDER	MACRO	;INSIDER START MACRO DEF
 IF DBRK==1
	CALL	DG000
 ENDIF
	ENDM

;************************************************************************
; DEMO PROGRAM THAT LOADS BYTE 55H TO DATA RAM ADDRESS 30H-3FH,
; BYTE 69H TO DATA RAM ADDRESS 40H-4FH, TO TEST THE INSIDER DISPLAY (D cmd)
; THEN THERE IS LOOP WHERE GPIO BITS:3-4-5 CONNECTED TO 3x PUSHBUTTONS ARE
; READ AND IF ANY IS PRESSED (0-INPUT) THE CORRESPONDING LED CONNECTED TO
; GPIO 0-1-2 IS TURNED ON.

VAR1	EQU	20H
VAR2	EQU	21H

;**************************************************************

START	BSF	STATUS,RP0	;INTERNAL OSCILATOR CAL VALUE @4MHz
	CALL	3FFH		;1us INSTRUCTION CYCLE
	MOVWF	OSCCAL

	BCF	STATUS,RP0
	MOVLW	07H		;DIGITAL MODE ON GPIO 0,1,2
	MOVWF	CMCON

	BSF	STATUS,RP0
	MOVLW	0F8H		;GPI0: 0-1-2-OUT 3-4-5-INPUT
	MOVWF	TRISIO		;NOTE THAT GPIO,2 WILL BE SHARED WITH
	BCF	STATUS,RP0	;THE INSIDER 1BIT INTERFACE

;*****************************************************
	MOVLW	0FFH
	MOVWF	GPIO		;INIT PORT '1'


	INSIDER		;INSIDER START MACRO LINE THAT STOPS THE CODE
			;EXECUTION TO WAIT FOR THE USER G cmd TO START


	MOVLW	30H
	MOVWF	FSR
	MOVLW	55H		;LOAD 55H -> 30H-3FH

	MOVWF	INDF
	INCF	FSR
	MOVWF	INDF
	INCF	FSR
	MOVWF	INDF
	INCF	FSR
	MOVWF	INDF
	INCF	FSR
	MOVWF	INDF
	INCF	FSR
	MOVWF	INDF
	INCF	FSR
	MOVWF	INDF
	INCF	FSR
	MOVWF	INDF
	INCF	FSR
	MOVWF	INDF
	INCF	FSR
	MOVWF	INDF
	INCF	FSR
	MOVWF	INDF
	INCF	FSR
	MOVWF	INDF
	INCF	FSR
	MOVWF	INDF
	INCF	FSR
	MOVWF	INDF
	INCF	FSR
	MOVWF	INDF
	INCF	FSR
	MOVWF	INDF

	MOVLW	40H
	MOVWF	FSR
	MOVLW	69H		;LOAD 69H -> 40H-4FH

	MOVWF	INDF
	INCF	FSR
	MOVWF	INDF
	INCF	FSR
	MOVWF	INDF
	INCF	FSR
	MOVWF	INDF

	BREAK	19H		;BREAK HERE TO CHECK THE DATA RAM WITH 
				;INSIDER cmd: D30.4F(CR)

	INCF	FSR
	MOVWF	INDF
	INCF	FSR
	MOVWF	INDF
	INCF	FSR
	MOVWF	INDF
	INCF	FSR
	MOVWF	INDF
	INCF	FSR
	MOVWF	INDF
	INCF	FSR
	MOVWF	INDF
	INCF	FSR
	MOVWF	INDF
	INCF	FSR
	MOVWF	INDF
	INCF	FSR
	MOVWF	INDF
	INCF	FSR
	MOVWF	INDF
	INCF	FSR
	MOVWF	INDF
	INCF	FSR
	MOVWF	INDF
LBL1	MOVF	GPIO,W		;READ KEY PRESS -> BIT 3-5

	BREAK	20H		;BREAK HERE TO CHECK THE DATA RAM WITH 
				;INSIDER cmd: D(CR)


	MOVWF	VAR1
	IORLW	0C7H
	XORLW	0FFH
	SKPNZ
	GOTO	LBL1
	BCF	STATUS,C
	BCF	STATUS,DC

	BREAK	21H		;BREAKE HERE AFTER ANY KEY PRESSED IN W


	MOVLW	0FFH
	MOVWF	VAR2		;SET VAR2-> FFH
	BTFSS	VAR1,3		;SET LEDS
	BCF	VAR2,0
	BTFSS	VAR1,4
	BCF	VAR2,1
	BTFSS	VAR1,5
	BCF	VAR2,2
	MOVF	VAR2,W
	MOVWF	GPIO
	GOTO	LBL1



 IF DBRK==1	;12F6DBUG: -- DEBUG INSIDER -- TARGET ROUTINE VR 1.0

DB0	EQU	5FH	   ;COMMON ACCESS AREA
DB1	EQU	5EH	   ;COMMON ACCESS AREA
DB2	EQU	5DH
DB3	EQU	5CH
DB4	EQU	5BH
DB5	EQU	5AH

;************** USER-PROG INITIALIZED DEBUG PIN/PORT FOR DIGITAL I/O
P	EQU	2	   ;DEBUG PIN     -- USER SELECTED I/O  PIN
#DEFINE X	GPIO,P	   ;DEBUG PORT    -- USER SELECTED CPU PORT-REG
#DEFINE T	TRISIO,P   ;TRIS REG NAME -- USER SELECTED CPU TRIS-REG
DBN	EQU	1	   ;SPEED MULTIPLIER: (1x), 2x, 4x, 8x

ENDPROG	EQU	3FFH	   ;USER SELECTED END-PROG-MEM - CHECK CPU TYPE -
; ------ BE CAREFUL WITH OSCCAL/CONFIG BYTE AT THE END OF PROG-MEM ------

 IF DBEE==1
 IFDEF	EECON1
	ORG	ENDPROG-.156
 ELSE
	ORG	ENDPROG-.142
 ENDIF
 ELSE
	ORG	ENDPROG-.142
 ENDIF

DG000	BCF	STATUS,RP1
	BSF	STATUS,RP0
	BCF	T
	BCF	STATUS,RP0
	BSF	X
	BTFSC	X
	GOTO	$-1
	BTFSS	X
	GOTO	$-1
	MOVLW	DBN
DBUG	MOVWF	DB1
	MOVF	STATUS,W
	CLRF	STATUS
	MOVWF	DB2
	MOVF	INTCON,W
	BCF	INTCON,GIE
	MOVWF	DB4
	MOVF	FSR,W
	MOVWF	DB3
DG001	BSF	X
	BSF	STATUS,RP0
	BCF	T
	CLRF	STATUS
	MOVLW	.10
	MOVWF	DB5
	CALL	DG005
	BCF	X
	MOVLW	.258-.64/DBN
	CALL	DG005
	MOVLW	.258-.128/DBN
	GOTO	$+9
	CALL	DG005
	MOVLW	.258-.64/DBN
	BCF	X
	CALL	DG005
	RRF	DB1
	MOVLW	.258-.160/DBN
	SKPC
	MOVLW	.258-.96/DBN
	BSF	X
	DECFSZ	DB5
	GOTO	$-.10
DG002	BSF	STATUS,RP0
	BSF	T
	CLRF	STATUS
	CALL	DG004
	BTFSS	DB1,7
	GOTO	$+.14
	BTFSS	DB1,6
	GOTO	$+3
	CALL	DG004
	CALL	DG004
	MOVF	DB3,W
	MOVWF	FSR
	MOVF	DB4,W
	MOVWF	INTCON
	MOVF	DB2,W
	MOVWF	STATUS
	SWAPF	DB0
	SWAPF	DB0,W
	RETURN
	BTFSC	DB1,4
	BTFSS	DB1,5
	GOTO	DG003
	CALL	DG004
 IF DBEE==1
 IFDEF	EECON1
	BSF	STATUS,RP0
	MOVF	EEADR,W
	MOVWF	FSR
	MOVF	DB1,W
	MOVWF	EEADR
	MOVF	EEDATA,W
	BSF	EECON1,0
	XORWF	EEDATA
	XORWF	EEDATA,W
	XORWF	EEDATA
	MOVWF	DB1
	MOVF	FSR,W
	MOVWF	EEADR
	CLRF	STATUS
 ENDIF
 ENDIF
	GOTO	DG001
DG003	MOVF	DB1,W
	MOVWF	FSR
	MOVLW	DB0
	BTFSC	DB1,4
	GOTO	$+.41
	MOVLW	DB2
	BTFSC	DB1,5
	GOTO	$+.38
	CALL	$+.48
	MOVLW	STATUS
	XORWF	DB1,W
	ANDLW	7FH
	MOVLW	DB2
	SKPNZ
	GOTO	$+.31
	MOVLW	FSR
	XORWF	DB1,W
	ANDLW	7FH
	MOVLW	DB3
	SKPNZ
	GOTO	$+.25
	MOVLW	INTCON
	XORWF	DB1,W
	ANDLW	7FH
	MOVLW	DB4
	SKPNZ
	GOTO	$+.19
	MOVLW	DB0
	XORWF	DB1,W
	ANDLW	7FH
	SKPNZ
	GOTO	$+.11
	MOVLW	DB2
	XORWF	DB1,W
	SKPNZ
	GOTO	$+7
	MOVLW	DB3
	XORWF	DB1,W
	SKPNZ
	GOTO	$+3
	MOVLW	DB4
	XORWF	DB1,W
	MOVLW	DB1
	SKPZ
	MOVF	DB1,W
	BTFSS	FSR,6
	GOTO	$+6
	MOVWF	FSR
	CALL	$+8
	MOVF	DB1,W
	MOVWF	INDF
	GOTO	DG002
	MOVWF	FSR
	MOVF	INDF,W
	MOVWF	DB1
	GOTO	DG001
DG004	MOVLW	9
	MOVWF	DB5
	BTFSC	X
	GOTO	$-1
	BTFSS	X
	GOTO	$-1
	DECFSZ	DB5
	GOTO	$+2
	RETURN
	CLRW
	ADDLW	1
	BTFSC	X
	GOTO	$-2
	ADDLW	.255-.128/DBN
	RRF	DB1
	GOTO	$-.11
DG005	ADDLW	1
	SKPZ
	GOTO	$-2
	RETURN
 ENDIF
	END
