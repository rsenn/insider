;*******************************************************
; 16FDBUG: -- DEBUG INSIDER -- TARGET ROUTINE VR 1.0
; COPYRIGHT(r) ATANASIOS MELIMOPOULOS (pic.insider@gmail.com)

;************** PLACE DEBUG ON/OFF MACRO AT USER-PROG-START

DBRK	EQU	1	;SET BREAKPOINTS-DEBUG ON/OFF 1/0
DBEE	EQU	1	;SET EEPROM-READ-CMD   ON/OFF 1/0
 noexpand

BREAK	MACRO	bkn	;BREAKPOINT MACRO DEF
 IF DBRK==1
	MOVWF	DB0
	MOVLW	bkn
	CALL	DBUG
 ENDIF
	ENDM

INSIDER	MACRO	;INSIDER START MACRO DEF
 IF DBRK==1
	CALL	DG000
 ENDIF
	ENDM

;************** PLACE TARGET INIT AFTER CPU I/O SETUP

	INSIDER

;************** PLACE AT BREAKPOINT ADR:

	BREAK	nn	;BREAKPOINT NUMBER: 00H-0FFH

;************** REPLACE DBUG LABEL/VAR NAMES IF USED BY THE USER-PROG
;************** PLACE DBUG-DATA-ADR AT 16Fxxx UNUSED BANK-0 DATA AREA
;************** PLACE THE FOLLOWING CODE AT THE END OF THE USER-PROG

 IF DBRK==1	;16FDBUG: -- DEBUG INSIDER -- TARGET ROUTINE VR 1.0
 NOLIST
DB0	EQU	7FH	   ;COMMON ACCESS AREA
DB1	EQU	7EH	   ;COMMON ACCESS AREA
DB2	EQU	6FH
DB3	EQU	6EH
DB4	EQU	6DH
DB5	EQU	6CH

;************** USER-PROG INITIALIZED DEBUG PIN/PORT FOR DIGITAL I/O
P	EQU	1	   ;DEBUG PIN     -- USER SELECTED I/O  PIN
#DEFINE X	PORTA,P	   ;DEBUG PORT    -- USER SELECTED CPU PORT-REG
#DEFINE T	TRISA,P	   ;TRIS REG NAME -- USER SELECTED CPU TRIS-REG
DBN	EQU	1	   ;SPEED MULTIPLIER: (1x), 2x, 4x, 8x

ENDPROG	EQU	800H	   ;USER SELECTED END-PROG-MEM - CHECK CPU TYPE -
; ------ BE CAREFUL WITH OSCCAL/CONFIG BYTE AT THE END OF PROG-MEM ------

 IF DBEE==1
 IFDEF	EECON1
	ORG	ENDPROG-.171
 ELSE
	ORG	ENDPROG-.147
 ENDIF
 ELSE
	ORG	ENDPROG-.147
 ENDIF

DG000	BCF	STATUS,RP1
	BSF	STATUS,RP0
	BCF	T
	BCF	STATUS,RP0
	BSF	X
	BTFSC	X
	GOTO	$-1
	BTFSS	X
	GOTO	$-1
	MOVLW	DBN
DBUG	MOVWF	DB1
	MOVF	STATUS,W
	CLRF	STATUS
	MOVWF	DB2
	MOVF	INTCON,W
	BCF	INTCON,GIE
	MOVWF	DB4
	MOVF	FSR,W
	MOVWF	DB3
DG001	BSF	X
	BSF	STATUS,RP0
	BCF	T
	CLRF	STATUS
	MOVLW	.10
	MOVWF	DB5
	CALL	DG005
	BCF	X
	MOVLW	.258-.64/DBN
	CALL	DG005
	MOVLW	.258-.128/DBN
	GOTO	$+9
	CALL	DG005
	MOVLW	.258-.64/DBN
	BCF	X
	CALL	DG005
	RRF	DB1
	MOVLW	.258-.160/DBN
	SKPC
	MOVLW	.258-.96/DBN
	BSF	X
	DECFSZ	DB5
	GOTO	$-.10
DG002	BSF	STATUS,RP0
	BSF	T
	CLRF	STATUS
	CALL	DG004
	BTFSS	DB1,7
	GOTO	$+.14
	BTFSS	DB1,6
	GOTO	$+3
	CALL	DG004
	CALL	DG004
	MOVF	DB3,W
	MOVWF	FSR
	MOVF	DB4,W
	MOVWF	INTCON
	MOVF	DB2,W
	MOVWF	STATUS
	SWAPF	DB0
	SWAPF	DB0,W
	RETURN
	BTFSC	DB1,4
	BTFSS	DB1,5
	GOTO	DG003
	CALL	DG004
 IF DBEE==1
 IFDEF	EECON1
	BANKSEL	EEADR
	MOVF	EEADR,W
	MOVWF	FSR
	MOVF	DB1,W
	MOVWF	EEADR
	MOVF	EEDATA,W
	MOVWF	DB1
	BANKSEL	EECON1
	MOVF	EECON1,W
	BCF	EECON1,7
	BSF	EECON1,0
	MOVWF	EECON1
	BANKSEL	EEADR
	MOVF	EEDATA,W
	XORWF	DB1
	XORWF	DB1,W
	XORWF	DB1
	MOVWF	EEDATA
	MOVF	FSR,W
	MOVWF	EEADR
	CLRF	STATUS
 ENDIF
 ENDIF
	GOTO	DG001
DG003	MOVF	DB1,W
	MOVWF	FSR
	MOVLW	DB0
	BTFSC	DB1,4
	GOTO	$+.46
	MOVLW	DB2
	BTFSC	DB1,5
	GOTO	$+.43
	CALL	$+.53
	MOVLW	STATUS
	XORWF	DB1,W
	ANDLW	7FH
	MOVLW	DB2
	SKPNZ
	GOTO	$+.36
	MOVLW	FSR
	XORWF	DB1,W
	ANDLW	7FH
	MOVLW	DB3
	SKPNZ
	GOTO	$+.30
	MOVLW	INTCON
	XORWF	DB1,W
	ANDLW	7FH
	MOVLW	DB4
	SKPNZ
	GOTO	$+.24
	MOVLW	DB0
	XORWF	DB1,W
	ANDLW	7FH
	SKPNZ
	GOTO	$+.13
	BTFSC	FSR,0
	GOTO	$+.15
	MOVLW	DB2
	XORWF	DB1,W
	SKPNZ
	GOTO	$+7
	MOVLW	DB3
	XORWF	DB1,W
	SKPNZ
	GOTO	$+3
	MOVLW	DB4
	XORWF	DB1,W
	MOVLW	DB1
	SKPNZ
	GOTO	$+4
	GOTO	$+2
	BSF	STATUS,IRP
	MOVF	DB1,W
	BTFSS	FSR,6
	GOTO	$+6
	MOVWF	FSR
	CALL	$+8
	MOVF	DB1,W
	MOVWF	INDF
	GOTO	DG002
	MOVWF	FSR
	MOVF	INDF,W
	MOVWF	DB1
	GOTO	DG001
DG004	MOVLW	9
	MOVWF	DB5
	BTFSC	X
	GOTO	$-1
	BTFSS	X
	GOTO	$-1
	DECFSZ	DB5
	GOTO	$+2
	RETURN
	CLRW
	ADDLW	1
	BTFSC	X
	GOTO	$-2
	ADDLW	.255-.128/DBN
	RRF	DB1
	GOTO	$-.11
DG005	ADDLW	1
	SKPZ
	GOTO	$-2
	RETURN
 LIST
 ENDIF
