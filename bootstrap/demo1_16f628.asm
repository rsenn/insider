;PROGRAM DEMO_16F628

 list		p=16F628, st=OFF
 #include	<p16F628.inc>
 errorlevel	-302
 errorlevel	-305
	
 __CONFIG _CP_OFF & _DATA_CP_OFF & _WDT_OFF & _BODEN_OFF & _PWRTE_ON & _MCLRE_OFF & _LVP_OFF & _INTRC_OSC_CLKOUT
;RA6 CLOCK OUT PIN 15

	ORG	00H

DBRK	EQU	1	;SET BREAKPOINTS-DEBUG ON/OFF 1/0
DBEE	EQU	1	;SET EEPROM-READ-CMD   ON/OFF 1/0
 noexpand
BREAK	MACRO	bkn	;BREAKPOINT MACRO DEF
 IF DBRK==1
	MOVWF	DB0
	MOVLW	bkn
	CALL	DBUG
 ENDIF
	ENDM
INSIDER	MACRO	;INSIDER START MACRO DEF
 IF DBRK==1
	CALL	DG000
 ENDIF
	ENDM

;************************************************************************
; DEMO PROGRAM THAT LOADS BYTE 55H TO DATA RAM ADDRESS 20H-2FH,
; BYTE 69H TO DATA RAM ADDRESS A0H-AFH, BYTE 73H TO DATA RAM ADDRESS 120H-12FH
; TO TEST THE INSIDER DISPLAY (D cmd)
; THEN THERE IS LOOP WHERE PORTB BITS:4-5-6-7 CONNECTED TO 4x PUSHBUTTONS ARE
; READ AND IF ANY IS PRESSED (0-INPUT) THE CORRESPONDING LED CONNECTED TO
; PORTB 0-1-2-3 IS TURNED ON.

VAR1	EQU	20H
VAR2	EQU	21H

;**************************************************************

	MOVLW	07H		;DIGITAL MODE
	MOVWF	CMCON
	BSF	STATUS,RP0
	MOVLW	0F0H
	MOVWF	TRISB		;RB7-4 INPUT, RB3-0 OUTPUT
	CLRF	STATUS		;SET RBANK0
	MOVLW	0FFH
	MOVWF	PORTB		;INIT PORT '1'


	INSIDER		;INSIDER START MACRO LINE THAT STOPS THE CODE
			;EXECUTION TO WAIT FOR THE USER G cmd TO START


	MOVLW	20H
	MOVWF	FSR
	MOVLW	55H		;LOAD 55H -> 20H-2FH

	MOVWF	INDF
	INCF	FSR
	MOVWF	INDF
	INCF	FSR
	MOVWF	INDF
	INCF	FSR
	MOVWF	INDF
	INCF	FSR
	MOVWF	INDF
	INCF	FSR
	MOVWF	INDF
	INCF	FSR
	MOVWF	INDF
	INCF	FSR
	MOVWF	INDF
	INCF	FSR
	MOVWF	INDF
	INCF	FSR
	MOVWF	INDF
	INCF	FSR
	MOVWF	INDF
	INCF	FSR
	MOVWF	INDF
	INCF	FSR
	MOVWF	INDF
	INCF	FSR
	MOVWF	INDF
	INCF	FSR
	MOVWF	INDF
	INCF	FSR
	MOVWF	INDF

	MOVLW	0A0H
	MOVWF	FSR
	MOVLW	69H		;LOAD 69H -> A0H-AFH

	MOVWF	INDF
	INCF	FSR
	MOVWF	INDF
	INCF	FSR
	MOVWF	INDF
	INCF	FSR
	MOVWF	INDF
	INCF	FSR
	MOVWF	INDF
	INCF	FSR
	MOVWF	INDF
	INCF	FSR
	MOVWF	INDF
	INCF	FSR
	MOVWF	INDF
	INCF	FSR
	MOVWF	INDF
	INCF	FSR
	MOVWF	INDF
	INCF	FSR
	MOVWF	INDF
	INCF	FSR
	MOVWF	INDF
	INCF	FSR
	MOVWF	INDF
	INCF	FSR
	MOVWF	INDF
	INCF	FSR
	MOVWF	INDF
	INCF	FSR
	MOVWF	INDF


	BREAK	19H		;BREAK HERE TO CHECK THE DATA RAM WITH 
				;INSIDER cmd: D20.2F A0.AF 120.12F(CR)


	MOVLW	20H
	BSF	STATUS,IRP	;SET BANK2-3
	MOVWF	FSR
	MOVLW	73H		;LOAD 73H -> 120H-12FH

	MOVWF	INDF
	INCF	FSR
	MOVWF	INDF
	INCF	FSR
	MOVWF	INDF
	INCF	FSR
	MOVWF	INDF
	INCF	FSR
	MOVWF	INDF
	INCF	FSR
	MOVWF	INDF
	INCF	FSR
	MOVWF	INDF
	INCF	FSR
	MOVWF	INDF
	INCF	FSR
	MOVWF	INDF
	INCF	FSR
	MOVWF	INDF
	INCF	FSR
	MOVWF	INDF
	INCF	FSR
	MOVWF	INDF
	INCF	FSR
	MOVWF	INDF
	INCF	FSR
	MOVWF	INDF
	INCF	FSR
	MOVWF	INDF
	INCF	FSR
	MOVWF	INDF
	CLRF	STATUS

LBL1	MOVF	PORTB,W		;READ KEY PRESS -> BIT 4-7


	BREAK	20H		;BREAK HERE TO CHECK THE DATA RAM WITH 
				;INSIDER cmd: D(CR)

	MOVWF	VAR1
	IORLW	0FH
	XORLW	0FFH
	SKPNZ
	GOTO	LBL1
	BCF	STATUS,C
	BCF	STATUS,DC


	BREAK	31H		;BREAKE HERE AFTER ANY KEY PRESSED IN W


	MOVLW	0FFH
	MOVWF	VAR2		;SET VAR2-> FFH
	BTFSS	VAR1,4		;SET LEDS
	BCF	VAR2,0
	BTFSS	VAR1,5
	BCF	VAR2,1
	BTFSS	VAR1,6
	BCF	VAR2,2
	BTFSS	VAR1,7
	BCF	VAR2,3
	MOVF	VAR2,W
	MOVWF	PORTB
	GOTO	LBL1


 IF DBRK==1	;16FDBUG: -- DEBUG INSIDER -- TARGET ROUTINE VR 1.0

DB0	EQU	7FH	   ;COMMON ACCESS AREA
DB1	EQU	7EH	   ;COMMON ACCESS AREA
DB2	EQU	6FH
DB3	EQU	6EH
DB4	EQU	6DH
DB5	EQU	6CH

;************** USER-PROG INITIALIZED DEBUG PIN/PORT FOR DIGITAL I/O
P	EQU	1	   ;DEBUG PIN     -- USER SELECTED I/O  PIN
#DEFINE X	PORTA,P	   ;DEBUG PORT    -- USER SELECTED CPU PORT-REG
#DEFINE T	TRISA,P	   ;TRIS REG NAME -- USER SELECTED CPU TRIS-REG
DBN	EQU	1	   ;SPEED MULTIPLIER: (1x), 2x, 4x, 8x

ENDPROG	EQU	800H	   ;USER SELECTED END-PROG-MEM - CHECK CPU TYPE -
; ------ BE CAREFUL WITH OSCCAL/CONFIG BYTE AT THE END OF PROG-MEM ------

 IF DBEE==1
 IFDEF	EECON1
	ORG	ENDPROG-.171
 ELSE
	ORG	ENDPROG-.147
 ENDIF
 ELSE
	ORG	ENDPROG-.147
 ENDIF

DG000	BCF	STATUS,RP1
	BSF	STATUS,RP0
	BCF	T
	BCF	STATUS,RP0
	BSF	X
	BTFSC	X
	GOTO	$-1
	BTFSS	X
	GOTO	$-1
	MOVLW	DBN
DBUG	MOVWF	DB1
	MOVF	STATUS,W
	CLRF	STATUS
	MOVWF	DB2
	MOVF	INTCON,W
	BCF	INTCON,GIE
	MOVWF	DB4
	MOVF	FSR,W
	MOVWF	DB3
DG001	BSF	X
	BSF	STATUS,RP0
	BCF	T
	CLRF	STATUS
	MOVLW	.10
	MOVWF	DB5
	CALL	DG005
	BCF	X
	MOVLW	.258-.64/DBN
	CALL	DG005
	MOVLW	.258-.128/DBN
	GOTO	$+9
	CALL	DG005
	MOVLW	.258-.64/DBN
	BCF	X
	CALL	DG005
	RRF	DB1
	MOVLW	.258-.160/DBN
	SKPC
	MOVLW	.258-.96/DBN
	BSF	X
	DECFSZ	DB5
	GOTO	$-.10
DG002	BSF	STATUS,RP0
	BSF	T
	CLRF	STATUS
	CALL	DG004
	BTFSS	DB1,7
	GOTO	$+.14
	BTFSS	DB1,6
	GOTO	$+3
	CALL	DG004
	CALL	DG004
	MOVF	DB3,W
	MOVWF	FSR
	MOVF	DB4,W
	MOVWF	INTCON
	MOVF	DB2,W
	MOVWF	STATUS
	SWAPF	DB0
	SWAPF	DB0,W
	RETURN
	BTFSC	DB1,4
	BTFSS	DB1,5
	GOTO	DG003
	CALL	DG004
 IF DBEE==1
 IFDEF	EECON1
	BANKSEL	EEADR
	MOVF	EEADR,W
	MOVWF	FSR
	MOVF	DB1,W
	MOVWF	EEADR
	MOVF	EEDATA,W
	MOVWF	DB1
	BANKSEL	EECON1
	MOVF	EECON1,W
	BCF	EECON1,7
	BSF	EECON1,0
	MOVWF	EECON1
	BANKSEL	EEADR
	MOVF	EEDATA,W
	XORWF	DB1
	XORWF	DB1,W
	XORWF	DB1
	MOVWF	EEDATA
	MOVF	FSR,W
	MOVWF	EEADR
	CLRF	STATUS
 ENDIF
 ENDIF
	GOTO	DG001
DG003	MOVF	DB1,W
	MOVWF	FSR
	MOVLW	DB0
	BTFSC	DB1,4
	GOTO	$+.46
	MOVLW	DB2
	BTFSC	DB1,5
	GOTO	$+.43
	CALL	$+.53
	MOVLW	STATUS
	XORWF	DB1,W
	ANDLW	7FH
	MOVLW	DB2
	SKPNZ
	GOTO	$+.36
	MOVLW	FSR
	XORWF	DB1,W
	ANDLW	7FH
	MOVLW	DB3
	SKPNZ
	GOTO	$+.30
	MOVLW	INTCON
	XORWF	DB1,W
	ANDLW	7FH
	MOVLW	DB4
	SKPNZ
	GOTO	$+.24
	MOVLW	DB0
	XORWF	DB1,W
	ANDLW	7FH
	SKPNZ
	GOTO	$+.13
	BTFSC	FSR,0
	GOTO	$+.15
	MOVLW	DB2
	XORWF	DB1,W
	SKPNZ
	GOTO	$+7
	MOVLW	DB3
	XORWF	DB1,W
	SKPNZ
	GOTO	$+3
	MOVLW	DB4
	XORWF	DB1,W
	MOVLW	DB1
	SKPNZ
	GOTO	$+4
	GOTO	$+2
	BSF	STATUS,IRP
	MOVF	DB1,W
	BTFSS	FSR,6
	GOTO	$+6
	MOVWF	FSR
	CALL	$+8
	MOVF	DB1,W
	MOVWF	INDF
	GOTO	DG002
	MOVWF	FSR
	MOVF	INDF,W
	MOVWF	DB1
	GOTO	DG001
DG004	MOVLW	9
	MOVWF	DB5
	BTFSC	X
	GOTO	$-1
	BTFSS	X
	GOTO	$-1
	DECFSZ	DB5
	GOTO	$+2
	RETURN
	CLRW
	ADDLW	1
	BTFSC	X
	GOTO	$-2
	ADDLW	.255-.128/DBN
	RRF	DB1
	GOTO	$-.11
DG005	ADDLW	1
	SKPZ
	GOTO	$-2
	RETURN
 ENDIF
	END
