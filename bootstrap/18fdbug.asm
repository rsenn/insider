;*******************************************************
; 18FDBUG: --- DEBUG INSIDER -- TARGET ROUTINE VR 1.0
; COPYRIGHT(r) ATANASIOS MELIMOPOULOS (pic.insider@gmail.com)

;************** PLACE DEBUG ON/OFF MACRO AT USER-PROG-START

DBRK	EQU	1	;SET BREAKPOINTS-DEBUG ON/OFF 1/0
 noexpand

BREAK	MACRO	bkn	;BREAKPOINT MACRO DEF
 IF DBRK==1
	MOVFF	WREG,DB0
	MOVLW	bkn
	CALL	DBUG
 ENDIF
	ENDM

INSIDER	MACRO	;INSIDER START MACRO DEF
 IF DBRK==1
	CALL	DG000
 ENDIF
	ENDM

;************** PLACE TARGET INIT AFTER CPU I/O SETUP

	INSIDER

;************** PLACE AT BREAKPOINT ADR:

	BREAK	nn	;BREAKPOINT NUMBER: 00H-0FFH

;************** REPLACE DBUG LABEL/VAR NAMES IF USED BY THE USER-PROG
;************** PLACE DBUG-DATA-ADR-GROUP AT ANY SPARE ADR-BANK
;************** PLACE THE FOLLOWING CODE AT THE END OF THE USER-PROG

 IF DBRK==1	;18FDBUG: -- DEBUG INSIDER -- TARGET ROUTINE VR 1.0
 NOLIST
DB0	EQU	0F7FH
DB1	EQU	0F7EH
DB2	EQU	0F7DH
DB3	EQU	0F7CH
DB4	EQU	0F7BH
DB5	EQU	0F7AH
DB6	EQU	0F79H

;************** USER-PROG DEBUG PIN/PORT INITIALIZED FOR DIGITAL I/O
PIN	EQU	2		;DEBUG PIN     -- USER SELECTED I/O  PIN
#DEFINE X	PORTD,PIN	;DEBUG PORT    -- USER SELECTED CPU PORT-REG
#DEFINE T	TRISD,PIN	;TRIS REG NAME -- USER SELECTED CPU TRIS-REG
DBN	EQU	1	   	;SPEED MULTIPLIER: (1x), 2x, 4x, 8x

	ORG	10000H-.396	;USER SELECTED END_PROG_MEM - DBUG(BYTES)
;CHECK CPU TYPE - BE CAREFUL WITH CONFIG-BYTES AT THE END OF PROG-MEM

DG000	BSF	X,0
	BCF	T,0
	BTFSC	X,0
	BRA	$-2
	BTFSS	X,0
	BRA	$-2
	MOVFF	WREG,DB0
	MOVLW	DBN
DBUG	MOVFF	INTCON,DB1
	BCF	INTCON,GIE,0
	MOVFF	STATUS,DB2
	MOVFF	FSR0L,DB3
	MOVFF	FSR0H,DB4
	MOVWF	FSR0L,0
	BSF	X,0
	BCF	T,0
	MOVLW	.10
	MOVWF	FSR0H,0
	RCALL	$+.342
	BCF	X,0
	MOVLW	.258-.64/DBN
	RCALL	$+.336
	MOVLW	.258-.128/DBN
	BRA	$+.18
	RCALL	$+.330
	MOVLW	.258-.64/DBN
	BCF	X,0
	RCALL	$+.324
	RRCF	FSR0L,1,0
	MOVLW	.258-.160/DBN
	BC	$+4
	MOVLW	.258-.96/DBN
	BSF	X,0
	DECFSZ	FSR0H,1,0
	BRA	$-.20
	BSF	T,0
	RCALL	$+.274
	BTFSS	FSR0L,7,0
	BRA	$+.46
	BTFSS	FSR0L,6,0
	BRA	$+.20
	MOVF	FSR0L,W,0
	MOVWF	TOSU,0
	RCALL	$+.260
	MOVF	FSR0L,W,0	
	MOVWF	TOSH,0
	RCALL	$+.254
	BCF	FSR0L,0,0
	MOVF	FSR0L,W,0
	MOVWF	TOSL,0
	MOVFF	DB0,WREG
	MOVFF	DB4,FSR0H
	MOVFF	DB3,FSR0L
	MOVFF	DB2,STATUS
	MOVFF	DB1,INTCON
	RETURN
	MOVFF	FSR0L,DB5
	BTFSC	FSR0L,4,0
	BTFSS	FSR0L,5,0
	BRA	$+.50
	RCALL	$+.214
	MOVFF	EEADRH,FSR0H
	MOVFF	DB5,EEADRH
	MOVFF	EEADR,DB5
	MOVFF	FSR0L,EEADR
	MOVFF	EEDATA,FSR0L
	MOVF	EECON1,W,0
	BCF	EECON1,7,0
	BCF	EECON1,6,0
	BSF	EECON1,0,0
	MOVWF	EECON1,0
	MOVFF	FSR0H,EEADRH
	MOVFF	DB5,EEADR
	MOVF	EEDATA,W,0
	MOVFF	FSR0L,EEDATA
	BRA	$-.152
	BTFSC	FSR0L,4,0
	BRA	$+.24
	BTFSC	FSR0L,5,0
	BRA	$+.30
	RCALL	$+.158
	MOVFF	DB5,WREG
	XORLW	HIGH WREG
	ANDLW	0FH
	BNZ	$+.52
	MOVLW	LOW WREG
	XORWF	FSR0L,W,0
	BNZ	$+6
	MOVLW	LOW DB0
	BRA	$+.84
	MOVLW	LOW STATUS
	XORWF	FSR0L,W,0
	BNZ	$+6
	MOVLW	LOW DB2
	BRA	$+.74
	MOVLW	LOW INTCON
	XORWF	FSR0L,W,0
	BNZ	$+6
	MOVLW	LOW DB1
	BRA	$+.64
	MOVLW	LOW FSR0L
	XORWF	FSR0L,W,0
	BNZ	$+6
	MOVLW	LOW DB3
	BRA	$+.54
	MOVLW	LOW FSR0H
	XORWF	FSR0L,W,0
	BNZ	$+6
	MOVLW	LOW DB4
	BRA	$+.44
	MOVFF	DB5,WREG
	XORLW	HIGH DB0
	ANDLW	0FH
	BNZ	$+.48
	MOVLW	LOW DB0
	XORWF	FSR0L,W,0
	BZ	$+.26
	MOVLW	LOW DB1
	XORWF	FSR0L,W,0
	BZ	$+.20
	MOVLW	LOW DB2
	XORWF	FSR0L,W,0
	BZ	$+.14
	MOVLW	LOW DB3
	XORWF	FSR0L,W,0
	BZ	$+8
	MOVLW	LOW DB4
	XORWF	FSR0L,W,0
	BNZ	$+.18
	MOVLW	LOW DB5
	MOVWF	FSR0L,0
	MOVFF	DB5,WREG
	ANDLW	0F0H
	IORLW	HIGH DB5
	MOVFF	WREG,DB5
	MOVFF	FSR0L,DB6
	MOVFF	DB5,FSR0L
	BTFSS	FSR0L,6,0
	BRA	$+.18
	RCALL	$+.28
	MOVF	FSR0L,W,0
	MOVFF	DB6,FSR0L
	MOVFF	DB5,FSR0H
	MOVWF	INDF0,0
	BRA	$-.262
	MOVFF	DB6,FSR0L
	MOVFF	DB5,FSR0H
	MOVF	INDF0,W,0
	BRA	$-.318
	MOVLW	9
	MOVWF	FSR0H,0
	BTFSC	X,0
	BRA	$-2
	BTFSS	X,0
	BRA	$-2
	DECFSZ	FSR0H,1,0
	BRA	$+4
	RETURN
	CLRF	WREG,0
	ADDLW	1
	BTFSC	X,0
	BRA	$-4
	ADDLW	.255-.128/DBN
	RRCF	FSR0L,1,0
	BRA	$-.22
	ADDLW	1
	BZ	$+4
	BRA	$-4
	RETURN
 LIST
 ENDIF
